// Generated by tools/wokwi_sketch.py from firmware/watertank/. Edit the files there.
// WaterTank: tank level monitor and automatic refill on an ESP32.
// Measures the water level with an ultrasonic sensor on the lid, refills the tank
// with a pump (or solenoid valve) between two levels, stops the pump if the water
// does not rise, beeps when the tank runs low, shows everything on a 128x64 OLED
// and talks to the web dashboard over MQTT with TLS.
//
// MQTT topics (base = watertank-th/<DEVICE_ID>):
//   base/state    every 5 s, retained   {"ts":1792330000,"level":56.4,"litres":564,"pump":false,"alarm":false,"fault":"none",...}
//   base/status   retained, LWT         "online" / "offline"
//   base/history  every minute, retained [[ts,level,pumpPct], ...] last 60 minutes
//   base/config   retained              {"mode":"auto","start":30,"stop":90,"alarm":15}
//   base/cmd      dashboard -> device   {"mode":"manual"} {"pump":true} {"start":35,"stop":90,"alarm":15} {"reset":true} {"silence":true}

#include <WiFi.h>
#include <WiFiClientSecure.h>
#include <PubSubClient.h>
#include <ArduinoJson.h>
#include <Preferences.h>
#include <Wire.h>
#include <Adafruit_GFX.h>
#include <Adafruit_SSD1306.h>
#include <time.h>

// ----- config.h -----
// Settings to change for a real installation. The defaults run as-is in the
// Wokwi simulator (Wokwi-GUEST is the simulator's open Wi-Fi with internet).

// Wi-Fi
#define WIFI_SSID "Wokwi-GUEST"
#define WIFI_PASS ""
#define WIFI_CHANNEL 6  // Wokwi-GUEST is on channel 6; use 0 (scan all) on real hardware

// MQTT broker. broker.emqx.io is a free public broker: fine for a demo, but
// anyone can read or publish on it. Use a private broker with a user and
// password (EMQX Cloud, HiveMQ Cloud, Mosquitto) for a real tank.
#define MQTT_HOST "broker.emqx.io"
#define MQTT_PORT 8883  // MQTT over TLS
#define MQTT_USER ""
#define MQTT_PASS ""

// Topics are watertank-th/<DEVICE_ID>/{state,status,history,config,cmd}.
#define DEVICE_ID "demo-01"

// Pins (ESP32 DevKit)
#define PIN_TRIG 5       // HC-SR04 trigger
#define PIN_ECHO 18      // HC-SR04 echo (use a divider to 3.3 V on a real 5 V sensor, or a JSN-SR04T 3.3 V module)
#define PIN_PUMP 26      // relay for the refill pump (or a solenoid valve)
#define PIN_BUZZER 27
#define PIN_PUMP_LED 25
#define PIN_ALARM_LED 33
#define PIN_BUTTON 4     // to GND: short press silences the buzzer, hold 2 s clears a fault
#define RELAY_ACTIVE_LOW false  // most blue relay boards switch on LOW: set true for those

// Tank. Measure on the real tank: distance from the sensor to the bottom, and to
// the water when the tank is full. Litres at 100 % (here a 1,000 L round tank).
#define TANK_EMPTY_CM 120.0f
#define TANK_FULL_CM 20.0f
#define TANK_LITRES 1000.0f

// Timing
#define SENSOR_PERIOD_MS 1000
#define PUBLISH_PERIOD_MS 5000
#define HISTORY_PERIOD_MS 60000   // one averaged point per minute, last 60 kept
// ----- end config.h -----
// ----- certs.h -----
// Root CA for broker.emqx.io (chain: *.emqx.io -> RapidSSL TLS RSA CA G1 -> DigiCert Global Root G2).
// Source: https://cacerts.digicert.com/DigiCertGlobalRootG2.crt.pem (valid until 2038-01-15).
// SHA-256 fingerprint CB:3C:CB:B7:60:31:E5:E0:13:8F:8D:D3:9A:23:F9:DE:47:FF:C3:5E:43:C1:14:4C:EA:27:D4:6A:5A:B1:CB:5F

static const char kRootCA[] = R"PEM(
-----BEGIN CERTIFICATE-----
MIIDjjCCAnagAwIBAgIQAzrx5qcRqaC7KGSxHQn65TANBgkqhkiG9w0BAQsFADBh
MQswCQYDVQQGEwJVUzEVMBMGA1UEChMMRGlnaUNlcnQgSW5jMRkwFwYDVQQLExB3
d3cuZGlnaWNlcnQuY29tMSAwHgYDVQQDExdEaWdpQ2VydCBHbG9iYWwgUm9vdCBH
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pLiaWN0bfVKfjllDiIGknibVb63dDcY3fe0Dkhvld1927jyNxF1WW6LZZm6zNTfl
MrY=
-----END CERTIFICATE-----
)PEM";
// ----- end certs.h -----
// ----- control.h -----
// Water level, refill pump and alarms for the tank. Plain C++ with no Arduino
// calls, so test/control_test.cpp can run it on a computer.

#include <stdint.h>

namespace watertank {

struct Settings {
  int startLevel = 30;   // start refilling at or below this % full
  int stopLevel = 90;    // stop refilling at or above this % full
  int alarmLevel = 15;   // buzzer and alert below this % full
  bool autoMode = true;
};

enum class Fault : uint8_t {
  None = 0,
  NoRise,   // pump runs but the level does not go up: dry well, closed valve, broken pipe
  MaxRun,   // pump ran longer than any normal refill could take
  Sensor,   // no echo from the ultrasonic sensor several times in a row
};

inline const char* faultName(Fault f) {
  switch (f) {
    case Fault::NoRise: return "norise";
    case Fault::MaxRun: return "maxrun";
    case Fault::Sensor: return "sensor";
    default: return "none";
  }
}

struct Outputs {
  bool pump = false;
  bool alarm = false;   // low water or a fault
  Fault fault = Fault::None;
};

// Safety limits. A 1,000 L tank refills from 30 % to 90 % in about 6 minutes on a
// 100 L/min pump, so 20 minutes of pumping always means something is wrong.
constexpr uint32_t kPumpMaxRunMs = 20UL * 60 * 1000;
constexpr uint32_t kRiseWindowMs = 3UL * 60 * 1000;  // while pumping, the level must rise...
constexpr float kMinRisePct = 2.0f;                   // ...at least this much in each window
constexpr int kSensorFailLimit = 5;                   // missed echoes in a row before a fault

inline bool settingsValid(int start, int stop, int alarm) {
  return alarm >= 5 && alarm < start && start >= 10 && stop <= 98 && stop - start >= 15;
}

// Distance from the sensor (on the lid) to the water, to % full.
// emptyCm: distance when the tank is empty; fullCm: distance at the full mark.
inline float levelPercent(float distanceCm, float emptyCm, float fullCm) {
  if (emptyCm <= fullCm) return 0;
  float pct = (emptyCm - distanceCm) * 100.0f / (emptyCm - fullCm);
  return pct < 0 ? 0 : pct > 100 ? 100 : pct;
}

// Median of the last 5 readings: ultrasonic sensors throw an odd echo off the
// tank wall now and then, and a median ignores it where an average would not.
class Median5 {
 public:
  float add(float v) {
    buf_[next_] = v;
    next_ = (next_ + 1) % 5;
    if (count_ < 5) count_++;
    float s[5];
    for (int i = 0; i < count_; i++) s[i] = buf_[i];
    for (int i = 1; i < count_; i++) {  // insertion sort, 5 items at most
      float x = s[i];
      int j = i - 1;
      while (j >= 0 && s[j] > x) { s[j + 1] = s[j]; j--; }
      s[j + 1] = x;
    }
    return s[count_ / 2];
  }

 private:
  float buf_[5] = {0, 0, 0, 0, 0};
  int next_ = 0;
  int count_ = 0;
};

class Controller {
 public:
  // level: % full; valid: false when the sensor gave no echo this time.
  // A NoRise or MaxRun fault stops the pump until clearFault() (button or dashboard),
  // because restarting a pump that runs dry would burn it out.
  Outputs update(float level, bool valid, const Settings& s, uint32_t now) {
    if (valid) {
      sensorFails_ = 0;
      level_ = level;
      if (fault_ == Fault::Sensor) fault_ = Fault::None;
    } else if (++sensorFails_ >= kSensorFailLimit) {
      fault_ = Fault::Sensor;
    }

    if (s.autoMode && valid) {
      if (level_ <= s.startLevel) wanted_ = true;
      else if (level_ >= s.stopLevel) wanted_ = false;
    }
    // Never overfill, in either mode.
    if (valid && level_ >= s.stopLevel) wanted_ = false;

    bool run = wanted_ && fault_ == Fault::None;
    if (run) {
      if (!pumpOn_) {
        pumpSince_ = now;
        windowStart_ = now;
        windowLevel_ = level_;
      }
      // Elapsed-time checks (now - start) stay correct when millis() wraps.
      if (now - pumpSince_ >= kPumpMaxRunMs) {
        fault_ = Fault::MaxRun;
        run = false;
      } else if (now - windowStart_ >= kRiseWindowMs) {
        if (level_ - windowLevel_ < kMinRisePct) {
          fault_ = Fault::NoRise;
          run = false;
        } else {
          windowStart_ = now;
          windowLevel_ = level_;
        }
      }
    }
    pumpOn_ = run;

    Outputs out;
    out.pump = pumpOn_;
    out.fault = fault_;
    out.alarm = fault_ != Fault::None || (sensorFails_ == 0 && level_ < s.alarmLevel);
    return out;
  }

  void setManualPump(bool on) { wanted_ = on; }
  bool pumpWanted() const { return wanted_; }

  // After fixing the cause (open the valve, prime the pump), clear the fault.
  void clearFault() {
    if (fault_ != Fault::Sensor) fault_ = Fault::None;
    wanted_ = false;
  }

 private:
  bool wanted_ = false;
  bool pumpOn_ = false;
  Fault fault_ = Fault::None;
  float level_ = 0;
  int sensorFails_ = 0;
  uint32_t pumpSince_ = 0;
  uint32_t windowStart_ = 0;
  float windowLevel_ = 0;
};

// Litres used today: every drop in level while the pump is off counts as use.
// Small wobbles (under 0.5 %) are ignored so sensor noise does not add up.
class UsageMeter {
 public:
  // day: local day number (changes at midnight); 0 if the clock is not set yet.
  void update(float level, bool pumpOn, uint32_t day, float tankLitres) {
    if (day != day_) {  // midnight: start the new day from the current level
      day_ = day;
      usedLitres_ = 0;
      refills_ = 0;
      ref_ = level;
      hasRef_ = true;
    }
    if (pumpOn) {
      if (!wasPumping_) refills_++;
      ref_ = level;
    } else if (!hasRef_ || level > ref_) {
      ref_ = level;
    } else if (ref_ - level >= kNoisePct) {
      usedLitres_ += (ref_ - level) / 100.0f * tankLitres;
      ref_ = level;
    }
    hasRef_ = true;
    wasPumping_ = pumpOn;
  }

  float usedLitres() const { return usedLitres_; }
  int refills() const { return refills_; }

 private:
  static constexpr float kNoisePct = 0.5f;
  uint32_t day_ = 0;
  float usedLitres_ = 0;
  int refills_ = 0;
  float ref_ = 0;
  bool hasRef_ = false;
  bool wasPumping_ = false;
};

}  // namespace watertank
// ----- end control.h -----

using watertank::Controller;
using watertank::Fault;
using watertank::Median5;
using watertank::Outputs;
using watertank::Settings;
using watertank::UsageMeter;

static const char* kFirmware = "1.0.0";

static const String kBase = String("watertank-th/") + DEVICE_ID;
static const String kTopicState = kBase + "/state";
static const String kTopicStatus = kBase + "/status";
static const String kTopicHistory = kBase + "/history";
static const String kTopicConfig = kBase + "/config";
static const String kTopicCmd = kBase + "/cmd";

WiFiClientSecure tls;
PubSubClient mqtt(tls);
Preferences prefs;
Adafruit_SSD1306 oled(128, 64, &Wire, -1);
bool oledOk = false;

Controller controller;
Settings settings;
Outputs outputs;
Median5 median;
UsageMeter usage;
float distanceCm = 0;   // filtered distance to the water
float level = 0;        // % full
bool levelOk = false;   // false when the last echo was missing
bool silenced = false;  // buzzer muted by the button or the dashboard until the alarm clears

// One averaged point per minute for the dashboard chart.
struct Sample { uint32_t ts; float level, pump; };
constexpr int kHistory = 60;
Sample history[kHistory];
int historyCount = 0;
float accLevel = 0, accPump = 0;
int accN = 0;

uint32_t lastSensor = 0, lastPublish = 0, lastHistory = 0, lastMqttTry = 0, lastWifiTry = 0;
uint32_t mqttRetryMs = 2000;
bool configDirty = true;
bool clockStarted = false;

// Unix time once NTP has answered, 0 before that.
uint32_t nowEpoch() {
  time_t t = time(nullptr);
  return t > 1700000000 ? uint32_t(t) : 0;
}

// Local (UTC+7) day number, so "used today" resets at midnight Thai time.
uint32_t today() {
  uint32_t t = nowEpoch();
  return t ? (t + 7 * 3600) / 86400 : 0;
}

// ---------- outputs ----------

void writeRelay(int pin, bool on) {
  digitalWrite(pin, (on ^ RELAY_ACTIVE_LOW) ? HIGH : LOW);
}

void applyOutputs() {
  writeRelay(PIN_PUMP, outputs.pump);
  digitalWrite(PIN_PUMP_LED, outputs.pump);
  digitalWrite(PIN_ALARM_LED, outputs.alarm);
  if (!outputs.alarm) silenced = false;  // the next alarm beeps again
}

// Beep 0.3 s every second while an alarm is active and not silenced.
void driveBuzzer() {
  static bool on = false;
  bool want = outputs.alarm && !silenced && (millis() % 1000) < 300;
  if (want == on) return;
  on = want;
  if (on) tone(PIN_BUZZER, 2200);
  else noTone(PIN_BUZZER);
}

// ---------- settings (kept in flash across restarts) ----------

void loadSettings() {
  prefs.begin("watertank", true);
  int start = prefs.getInt("start", settings.startLevel);
  int stop = prefs.getInt("stop", settings.stopLevel);
  int alarm = prefs.getInt("alarm", settings.alarmLevel);
  settings.autoMode = prefs.getBool("auto", settings.autoMode);
  prefs.end();
  if (watertank::settingsValid(start, stop, alarm)) {
    settings.startLevel = start;
    settings.stopLevel = stop;
    settings.alarmLevel = alarm;
  }
}

void saveSettings() {
  prefs.begin("watertank", false);
  prefs.putInt("start", settings.startLevel);
  prefs.putInt("stop", settings.stopLevel);
  prefs.putInt("alarm", settings.alarmLevel);
  prefs.putBool("auto", settings.autoMode);
  prefs.end();
  configDirty = true;
}

void setAutoMode(bool on) {
  if (settings.autoMode == on) return;
  settings.autoMode = on;
  // Switching to manual keeps whatever is running, so nothing jumps.
  if (!on) controller.setManualPump(outputs.pump);
  saveSettings();
  Serial.printf("mode -> %s\n", on ? "auto" : "manual");
}

// ---------- sensor ----------

// HC-SR04: a 10 us pulse on TRIG, then ECHO stays high for the sound's round trip.
// Returns the distance in cm, or -1 when no echo came back within 30 ms (~5 m).
float measureDistance() {
  digitalWrite(PIN_TRIG, LOW);
  delayMicroseconds(2);
  digitalWrite(PIN_TRIG, HIGH);
  delayMicroseconds(10);
  digitalWrite(PIN_TRIG, LOW);
  unsigned long us = pulseIn(PIN_ECHO, HIGH, 30000);
  return us ? us * 0.0343f / 2 : -1;
}

void readSensor() {
  float d = measureDistance();
  levelOk = d > 0;
  if (levelOk) {
    distanceCm = median.add(d);
    level = watertank::levelPercent(distanceCm, TANK_EMPTY_CM, TANK_FULL_CM);
    usage.update(level, outputs.pump, today(), TANK_LITRES);
    accLevel += level;
    accPump += outputs.pump ? 100 : 0;
    accN++;
  }
}

void pushHistory() {
  if (!accN) return;
  Sample s = {nowEpoch(), accLevel / accN, accPump / accN};
  if (historyCount < kHistory) {
    history[historyCount++] = s;
  } else {
    memmove(history, history + 1, sizeof(Sample) * (kHistory - 1));
    history[kHistory - 1] = s;
  }
  accLevel = accPump = 0;
  accN = 0;
}

// ---------- MQTT ----------

void publishJson(const String& topic, JsonDocument& doc, bool retained) {
  String out;
  serializeJson(doc, out);
  if (!mqtt.publish(topic.c_str(), out.c_str(), retained)) Serial.printf("publish failed: %s\n", topic.c_str());
}

void publishState() {
  JsonDocument doc;
  if (nowEpoch()) doc["ts"] = nowEpoch();
  doc["level"] = round(level * 10) / 10.0;
  doc["litres"] = int(level / 100 * TANK_LITRES + 0.5f);
  doc["distance"] = round(distanceCm * 10) / 10.0;
  doc["sensorOk"] = outputs.fault != Fault::Sensor;
  doc["pump"] = outputs.pump;
  doc["alarm"] = outputs.alarm;
  doc["silenced"] = silenced;
  doc["fault"] = watertank::faultName(outputs.fault);
  doc["mode"] = settings.autoMode ? "auto" : "manual";
  doc["usedToday"] = int(usage.usedLitres() + 0.5f);
  doc["refillsToday"] = usage.refills();
  doc["rssi"] = WiFi.RSSI();
  doc["uptime"] = millis() / 1000;
  doc["fw"] = kFirmware;
  publishJson(kTopicState, doc, true);
}

void publishConfig() {
  JsonDocument doc;
  doc["mode"] = settings.autoMode ? "auto" : "manual";
  doc["start"] = settings.startLevel;
  doc["stop"] = settings.stopLevel;
  doc["alarm"] = settings.alarmLevel;
  doc["tankLitres"] = int(TANK_LITRES);
  publishJson(kTopicConfig, doc, true);
  configDirty = false;
}

void publishHistory() {
  JsonDocument doc;
  JsonArray rows = doc.to<JsonArray>();
  for (int i = 0; i < historyCount; i++) {
    JsonArray r = rows.add<JsonArray>();
    r.add(history[i].ts);
    r.add(round(history[i].level * 10) / 10.0);
    r.add(round(history[i].pump));
  }
  publishJson(kTopicHistory, doc, true);
}

void onCommand(char* topic, byte* payload, unsigned int len) {
  JsonDocument doc;
  if (deserializeJson(doc, payload, len)) {
    Serial.println("bad command json");
    return;
  }
  Serial.printf("cmd %.*s\n", len, (const char*)payload);
  if (doc["mode"].is<const char*>()) setAutoMode(strcmp(doc["mode"], "auto") == 0);
  if (!settings.autoMode && doc["pump"].is<bool>()) controller.setManualPump(doc["pump"].as<bool>());
  if (doc["reset"] | false) {
    controller.clearFault();
    Serial.println("fault cleared from dashboard");
  }
  if (doc["silence"] | false) silenced = true;
  int start = doc["start"] | settings.startLevel;
  int stop = doc["stop"] | settings.stopLevel;
  int alarm = doc["alarm"] | settings.alarmLevel;
  if ((start != settings.startLevel || stop != settings.stopLevel || alarm != settings.alarmLevel) &&
      watertank::settingsValid(start, stop, alarm)) {
    settings.startLevel = start;
    settings.stopLevel = stop;
    settings.alarmLevel = alarm;
    saveSettings();
  }
  configDirty = true;
  // React at once instead of waiting for the next sensor tick.
  outputs = controller.update(level, levelOk, settings, millis());
  applyOutputs();
  publishState();
}

void ensureMqtt() {
  if (mqtt.connected() || WiFi.status() != WL_CONNECTED) return;
  if (millis() - lastMqttTry < mqttRetryMs) return;
  lastMqttTry = millis();
  String clientId = String("watertank-") + DEVICE_ID + "-" + String((uint32_t)ESP.getEfuseMac(), HEX);
  Serial.printf("MQTT connecting to %s:%d ... ", MQTT_HOST, MQTT_PORT);
  bool ok = strlen(MQTT_USER)
    ? mqtt.connect(clientId.c_str(), MQTT_USER, MQTT_PASS, kTopicStatus.c_str(), 1, true, "offline")
    : mqtt.connect(clientId.c_str(), kTopicStatus.c_str(), 1, true, "offline");
  if (!ok) {
    Serial.printf("failed, state %d\n", mqtt.state());
    mqttRetryMs = min<uint32_t>(mqttRetryMs * 2, 30000);  // back off up to 30 s
    return;
  }
  Serial.println("connected");
  mqttRetryMs = 2000;
  mqtt.publish(kTopicStatus.c_str(), "online", true);
  mqtt.subscribe(kTopicCmd.c_str(), 1);
  publishConfig();
  publishHistory();
}

void ensureWifi() {
  if (WiFi.status() == WL_CONNECTED) {
    if (!clockStarted) {
      clockStarted = true;
      configTzTime("ICT-7", "pool.ntp.org", "time.google.com");  // Thailand, UTC+7
    }
    return;
  }
  if (millis() - lastWifiTry < 20000 && lastWifiTry) return;  // give a slow DHCP time before retrying
  lastWifiTry = millis();
  Serial.printf("WiFi connecting to %s\n", WIFI_SSID);
  WiFi.disconnect();
  WiFi.begin(WIFI_SSID, WIFI_PASS, WIFI_CHANNEL);
}

// ---------- OLED ----------

void drawScreen() {
  if (!oledOk) return;
  oled.clearDisplay();
  oled.setTextColor(SSD1306_WHITE);
  oled.setTextSize(1);
  oled.setCursor(0, 0);
  oled.print("WaterTank");
  oled.setCursor(104, 0);  // 4 characters, right-aligned on the 128 px line
  oled.print(WiFi.status() == WL_CONNECTED ? (mqtt.connected() ? "LIVE" : "WIFI") : "----");
  oled.drawFastHLine(0, 10, 128, SSD1306_WHITE);

  // tank outline on the right, filled to the level
  oled.drawRect(104, 14, 22, 48, SSD1306_WHITE);
  int h = int(level / 100 * 46 + 0.5f);
  oled.fillRect(105, 61 - h, 20, h, SSD1306_WHITE);

  oled.setTextSize(2);
  oled.setCursor(0, 15);
  if (outputs.fault == Fault::Sensor) oled.print("--");
  else oled.printf("%d%%", int(level + 0.5f));
  oled.setTextSize(1);
  oled.setCursor(56, 15);
  oled.printf("%4dL", int(level / 100 * TANK_LITRES + 0.5f));
  oled.setCursor(56, 24);
  oled.print(settings.autoMode ? "AUTO" : "MAN");

  oled.setCursor(0, 36);
  oled.printf("Pump %s", outputs.pump ? "ON" : "off");
  oled.setCursor(0, 46);
  switch (outputs.fault) {
    case Fault::NoRise: oled.print("NO RISE! hold btn"); break;
    case Fault::MaxRun: oled.print("RUN TOO LONG!"); break;
    case Fault::Sensor: oled.print("SENSOR ERROR"); break;
    default:
      if (outputs.alarm) oled.print("LOW WATER!");
      else oled.printf("Fill %d-%d%%", settings.startLevel, settings.stopLevel);
  }
  oled.setCursor(0, 56);
  oled.printf("Used %dL", int(usage.usedLitres() + 0.5f));
  oled.display();
}

// ---------- button ----------

// Short press: silence the buzzer. Hold 2 s: clear a pump fault after fixing it.
void checkButton() {
  static bool last = HIGH;
  static uint32_t pressedAt = 0;
  static bool held = false;
  bool now = digitalRead(PIN_BUTTON);
  if (now == LOW && last == HIGH) {
    pressedAt = millis();
    held = false;
  }
  if (now == LOW && !held && millis() - pressedAt >= 2000) {
    held = true;
    controller.clearFault();
    Serial.println("fault cleared by button");
  }
  if (now == HIGH && last == LOW && !held && millis() - pressedAt > 40) silenced = true;
  last = now;
}

// ---------- main ----------

void setup() {
  Serial.begin(115200);
  pinMode(PIN_TRIG, OUTPUT);
  pinMode(PIN_ECHO, INPUT);
  pinMode(PIN_PUMP, OUTPUT);
  pinMode(PIN_PUMP_LED, OUTPUT);
  pinMode(PIN_ALARM_LED, OUTPUT);
  pinMode(PIN_BUZZER, OUTPUT);
  pinMode(PIN_BUTTON, INPUT_PULLUP);
  applyOutputs();  // everything off until the first reading

  loadSettings();
  oledOk = oled.begin(SSD1306_SWITCHCAPVCC, 0x3C);
  if (!oledOk) Serial.println("OLED not found");

  WiFi.mode(WIFI_STA);
  tls.setCACert(kRootCA);
  // Short network timeouts: a broker that does not answer must not stall the
  // control loop (and the pump safety checks) for long.
  tls.setHandshakeTimeout(5);
  mqtt.setSocketTimeout(5);
  mqtt.setServer(MQTT_HOST, MQTT_PORT);
  mqtt.setCallback(onCommand);
  mqtt.setBufferSize(2048);  // the history message is about 1.3 KB
  mqtt.setKeepAlive(30);
  Serial.printf("WaterTank %s starting\n", DEVICE_ID);
}

void loop() {
  ensureWifi();
  ensureMqtt();
  mqtt.loop();
  checkButton();
  driveBuzzer();

  uint32_t now = millis();
  if (now - lastSensor >= SENSOR_PERIOD_MS || !lastSensor) {
    lastSensor = now;
    readSensor();
    Outputs before = outputs;
    outputs = controller.update(level, levelOk, settings, now);
    applyOutputs();
    if (before.pump != outputs.pump || before.fault != outputs.fault || before.alarm != outputs.alarm) {
      Serial.printf("pump %d alarm %d fault %s (level %.1f%%)\n", outputs.pump, outputs.alarm, watertank::faultName(outputs.fault), level);
      if (mqtt.connected()) publishState();
    }
    drawScreen();
  }
  if (mqtt.connected()) {
    if (now - lastPublish >= PUBLISH_PERIOD_MS) {
      lastPublish = now;
      publishState();
    }
    if (configDirty) publishConfig();
    if (now - lastHistory >= HISTORY_PERIOD_MS) {
      lastHistory = now;
      pushHistory();
      publishHistory();
    }
  }
  delay(10);
}
